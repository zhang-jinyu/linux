## Documentation/devicetree/bindings/iio/adc/adi,ad4130.yaml
```yaml
# SPDX-License-Identifier: (GPL-2.0 OR BSD-2-Clause)
# Copyright 2022 Analog Devices Inc.
%YAML 1.2
---
$id: http://devicetree.org/schemas/iio/adc/adi,ad4130.yaml#
$schema: http://devicetree.org/meta-schemas/core.yaml#

title: Analog Devices AD4130 ADC device driver

maintainers:
  - Cosmin Tanislav <cosmin.tanislav@analog.com>

description: |
  Bindings for the Analog Devices AD4130 ADC. Datasheet can be found here:
    https://www.analog.com/media/en/technical-documentation/data-sheets/AD4130-8.pdf

properties:
  compatible:
    enum:
      - adi,ad4130-8-16-lfcsp
      - adi,ad4130-8-16-wlcsp
      - adi,ad4130-8-24-lfcsp
      - adi,ad4130-8-24-wlcsp

  reg:
    maxItems: 1

  clocks:
    maxItems: 1
    description: phandle to the master clock (mclk)

  clock-names:
    items:
      - const: mclk

  interrupts:
    minItems: 1
    maxItems: 1

  interrupt-names:
    minItems: 1
    maxItems: 1
    description:
      Default if not supplied is dout-int.
    items:
      enum:
        - dout-int
        - clk
        - p1
        - dout

  '#address-cells':
    const: 1

  '#size-cells':
    const: 0

  refin1-supply:
    description: refin1 supply. Can be used as reference for conversion.

  refin2-supply:
    description: refin2 supply. Can be used as reference for conversion.

  avdd-supply:
    description: AVDD voltage supply. Can be used as reference for conversion.

  iovdd-supply:
    description: IOVDD voltage supply. Used for the chip interface.

  spi-max-frequency:
    maximum: 5000000

  adi,mclk-sel:
    description: |
      Select the clock.
      0: Internal 76.8kHz clock.
      1: Internal 76.8kHz clock, output to the CLK pin.
      2: External 76.8kHz clock.
      3. External 153.6kHz clock.
    $ref: /schemas/types.yaml#/definitions/uint32
    enum: [0, 1, 2, 3]
    default: 0

  adi,int-ref-en:
    description: |
      Specify if internal reference should be enabled.
    type: boolean
    default: true

  adi,bipolar:
    description: Specify if the device should be used in bipolar mode.
    type: boolean
    default: false

  adi,vbias-pins:
    description: Analog inputs to apply a voltage bias of (AVDD − AVSS) / 2 to.
    items:
      minimum: 0
      maximum: 15

required:
  - compatible
  - reg
  - interrupts

patternProperties:
  "^channel@([0-9]|1[0-5])$":
    type: object
    $ref: adc.yaml

    properties:
      reg:
        description: |
          The channel number.
        items:
          minimum: 0
          maximum: 15

      diff-channels:
        description: |
          Besides the analog inputs available, internal inputs can be used.
          16: Internal temperature sensor.
          17: AVss
          18: Internal reference.
          19: DGND.
          20: (AVDD − AVSS)/6+
          21: (AVDD − AVSS)/6-
          22: (IOVDD − DGND)/6+
          23: (IOVDD − DGND)/6-
          24: (ALDO − AVSS)/6+
          25: (ALDO − AVSS)/6-
          26: (DLDO − DGND)/6+
          27: (DLDO − DGND)/6-
          28: V_MV_P
          29: V_MV_M
        $ref: adc.yaml
        items:
          minimum: 0
          maximum: 29

      adi,reference-select:
        description: |
          Select the reference source to use when converting on the
          specific channel. Valid values are:
          0: REFIN1(+)/REFIN1(−).
          1: REFIN2(+)/REFIN2(−).
          2: REFOUT/AVSS (Internal reference)
          3: AVDD/AVSS
          If not specified, internal reference is used.
        $ref: /schemas/types.yaml#/definitions/uint32
        enum: [0, 1, 2, 3]
        default: 2

      adi,excitation-pin-0:
        description: |
          Analog input to apply excitation current to while the channel
          is active.
        minimum: 0
        maximum: 15
        default: 0

      adi,excitation-pin-1:
        description: |
          Analog input to apply excitation current to while this channel
          is active.
        $ref: /schemas/types.yaml#/definitions/uint32
        minimum: 0
        maximum: 15
        default: 0

      adi,excitation-current-0-nanoamps:
        description: |
          Excitation current in nanoamps to be applied to pin specified in
          adi,excitation-pin-0 while this channel is active.
        $ref: /schemas/types.yaml#/definitions/uint32
        enum: [0, 100, 10000, 20000, 50000, 100000, 150000, 200000]
        default: 0

      adi,excitation-current-1-nanoamps:
        description: |
          Excitation current in nanoamps to be applied to pin specified in
          adi,excitation-pin-1 while this channel is active.
        $ref: /schemas/types.yaml#/definitions/uint32
        enum: [0, 100, 10000, 20000, 50000, 100000, 150000, 200000]
        default: 0

      adi,burnout-current-nanoamps:
        description: |
          Burnout current in nanoamps to be applied for this channel.
        $ref: /schemas/types.yaml#/definitions/uint32
        enum: [0, 500, 2000, 4000]
        default: 0

      adi,buffered-positive:
        description: Enable buffered mode for positive input.
        type: boolean

      adi,buffered-negative:
        description: Enable buffered mode for negative input.
        type: boolean

    required:
      - reg
      - diff-channels

additionalProperties: false

examples:
  - |
    spi {
      #address-cells = <1>;
      #size-cells = <0>;

      adc@0 {
        compatible = "adi,ad4130-8-24-wlcsp";
        reg = <0>;

        #address-cells = <1>;
        #size-cells = <0>;

        spi-max-frequency = <5000000>;
        interrupts = <27 IRQ_TYPE_EDGE_FALLING>;
        interrupt-parent = <&gpio>;

        channel@0 {
          reg = <0>;
          /* AIN8, AIN9 */
          diff-channels = <8 9>;
        };

        channel@1 {
          reg = <1>;
          /* AIN10, AIN11 */
          diff-channels = <10 11>;
        };

        channel@2 {
          reg = <2>;
          /* Temperature Sensor, DGND */
          diff-channels = <16 19>;
        };

        channel@3 {
          reg = <3>;
          /* Internal reference, DGND */
          diff-channels = <18 19>;
        };

        channel@4 {
          reg = <4>;
          /* DGND, DGND */
          diff-channels = <19 19>;
        };
      };
    };
```

## Documentation/devicetree/bindings/iio/adc/adi,ad4630.yaml
```yaml
# SPDX-License-Identifier: (GPL-2.0-only OR BSD-2-Clause)
# Copyright 2022 Analog Devices Inc.
%YAML 1.2
---
$id: http://devicetree.org/schemas/bindings/iio/adc/adi,ad4630.yaml#
$schema: http://devicetree.org/meta-schemas/core.yaml#

title: Analog Devices AD4630 ADC family device driver

maintainers:
  - Sergiu Cuciurean <sergiu.cuciurean@analog.com>

description: |
  Analog Devices AD4630 Dual Channel Precision SAR ADC family

properties:
  compatible:
    enum:
      - adi,ad4630-24
      - adi,ad4030-24

  reg:
    description:
      SPI chip select number for the device
    maxItems: 1

  vref-supply:
    description:
      Voltage regulator used as full scale voltage refecernce by the ADC.

  reset-gpios:
    description:
      Gpio tied to the reset pin of the ADC.

  dmas:
    description:
      DMA controller used to store the data received over spi in buffered mode.

  dma-names:
    description:
      DMA controller name
    const: "rx"

  pwms:
    description:
      The ADC needs a periodic trigger signal in order to achieve continuous
      sampling. This pwm handle is used to configure the external trigger and
      to start the conversion.

required:
  - compatible
  - reg
  - vref-supply
  - reset-gpios
  - dmas
  - pwms

examples:
  - |
    adc@0 {
      compatible = "adi,ad463x";
      reg = <0>;
      vref-supply = <&vref>;
      reset-gpios = <&gpio 1 GPIO_ACTIVE_LOW>;
      dmas = <&dma 0>;
      dma-names = "rx";
      pwms = <&pwm 0 10000>;
      spi-max-frequency = <80000000>;
    };
```

## drivers/iio/addac/Kconfig
```kconfig
#
# ADC DAC drivers
#
# When adding new entries keep the list in alphabetical order

menu "Analog to digital and digital to analog converters"

config ONE_BIT_ADC_DAC
	tristate "Analog Devices ONE_BIT_ADC_DAC driver"
	help
	  Say yes here to build support for Analog Devices ONE_BIT_ADC_DAC
	  driver.

 	  To compile this driver as a module, choose M here: the
	  module will be called one-bit-adc-dac.

config AD7293
	tristate "Analog Devices AD7293 Power Amplifier Current Controller"
	depends on SPI
	help
	  Say yes here to build support for Analog Devices AD7293
	  12-Bit Power Amplifier Current Controller with ADC, DACs,
          and Temperature and Current Sensors

	  To compile this driver as a module, choose M here: the
	  module will be called ad7293.

endmenu
```

## drivers/iio/rf-transceiver/Kconfig
```kconfig
#
# RF TRANSVEIVERS drivers
#
# When adding new entries keep the list in alphabetical order
menu "RF Transceivers"

config ADRV9001_NEW
        tristate "Analog Devices ADRV9001/ADRV9002 RF Transceiver driver"
        depends on SPI
        help
          Say yes here to build support for Analog Devices:
          ADRV9001/ADRV9002 RF Transceivers. Provides direct access
          via sysfs

endmenu
```
