// SPDX-License-Identifier: GPL-2.0
/*
 * Analog Devices AD9208 / AD9689 ANALOG-TO-DIGITAL CONVERTER
 * https://wiki.analog.com/resources/eval/ad9208-3000ebz
 * https://wiki.analog.com/resources/tools-software/linux-drivers/iio-adc/ad9208
 *
 * hdl_project: <ad9208/zcu102>
 * board_revision: <>
 *
 * Copyright (C) 2019-2020 Analog Devices Inc.
 */

#include "zynqmp-zcu102-rev10-ad9208.dts"
#include <dt-bindings/iio/frequency/hmc7044.h>

&spi0 {
	status = "okay";

	adc0_ad9208: ad9208@0 {
		adi,sampling-frequency = /bits/ 64 <1277952000>;
	};
};

